## drivers/gpu/arm/mali400/Kconfig
```kconfig
menuconfig MALI400
	bool "Mali-400 support"
	depends on ARM
	default n
	select DMA_SHARED_BUFFER
	---help---
	  This enables support for the ARM Mali-400 GPU.

choice
depends on MALI400
prompt "Select MALI VER"
default MALI_VER_R4P0_REL0

config MALI_VER_R4P0_REL0
	bool "Mali400 Version R4P0-REL0"
	help
	  Choose this option to select DDK version.

if MALI_VER_R4P0_REL0
source "drivers/gpu/arm/mali400/r4p0_rel0/Kconfig"
endif

config MALI_VER_R5P0_REL0
	bool "Mali400 Version R5P0-REL0"
	help
	  Choose this option to select DDK version.

if MALI_VER_R5P0_REL0
source "drivers/gpu/arm/mali400/r5p0_rel0/Kconfig"
endif

config MALI_VER_R5P2_REL0
	bool "Mali400 Version R5P2-REL0"
	help
	  Choose this option to select DDK version.

if MALI_VER_R5P2_REL0
source "drivers/gpu/arm/mali400/r5p2_rel0/Kconfig"
endif

config MALI_VER_R6P2_01REL0
	bool "Mali400 Version R6P2-01REL0"
	help
	  Choose this option to select DDK version.

if MALI_VER_R6P2_01REL0
source "drivers/gpu/arm/mali400/r6p2_01rel0/Kconfig"
endif

endchoice
```
