&gen_panel {
	dsi_sc7798d_vid: gen-panel-sc7798d-video {
		gen-panel-manu = "BOE";			/* condensed manufacturer name */
		gen-panel-name = "sc7798d";
		gen-panel-id = <0x55b8f0>;
		gen-panel-dev-id = <0>;			/* SPRDFB_MAINLCD_ID : MAIN 0, SUB 1 */
		gen-panel-type = <2>;			/* LCD_MODE_DSI: MCU 0, RGB 1, DSI 2 */
		gen-panel-refresh = <60>;
		gen-panel-xres = <480>;
		gen-panel-yres = <800>;
		gen-panel-width= <59>;			/* screen width in mm */
		gen-panel-height = <98>;		/* screen height in mm */
		gen-panel-work-mode = <1>;		/*	SPRDFB_MIPI_MODE_VIDEO : CMD 0,
											VIDEO 1*/
		gen-panel-direction = <0>;		/* 	LCD_DIRECT_NORMAL : Normal 0,
											ROT90 1, ROT180 2, ROT270 3 */
		gen-panel-suspend-mode = <1>;	/* SEND_SLEEP_CMD : RST 0, SLEEP 1 */
		gen-panel-bus-width = <24>;
		gen-panel-lanes = <2>;
		gen-panel-phy-feq = <499000>;
		gen-panel-h-sync-pol = <0>;		/*SPRDFB_POLARITY_POS : POS 0, NEG 1 */
		gen-panel-v-sync-pol = <0>;		/*SPRDFB_POLARITY_POS : POS 0, NEG 1 */
		gen-panel-de-pol = <0>;			/*SPRDFB_POLARITY_POS : POS 0, NEG 1 */
		gen-panel-te-pol = <0>;			/*SPRDFB_POLARITY_POS : POS 0, NEG 1 */
		gen-panel-color-mode-pol = <1>;	/*SPRDFB_POLARITY_POS : POS 0, NEG 1 */
		gen-panel-shut-down-pol = <1>;	/*SPRDFB_POLARITY_POS : POS 0, NEG 1 */
		gen-panel-h-front-porch = <89>; /* hfp */
		gen-panel-h-back-porch = <89>;	/* hbp */
		gen-panel-h-sync-width = <112>;	/* hsync */
		gen-panel-v-front-porch = <16>;	/* vfp */
		gen-panel-v-back-porch = <12>;	/* vbp */
		gen-panel-v-sync-width = <4>;	/* vsync */

		/*
		 * DSI PACKET HEADER INFO
		 * @ delay(msec) : 2byte
		 * @ size of data : 2byte
		 */
		gen-panel-pkt-dinfo-addr-offset = <0>;
		gen-panel-pkt-dinfo-addr-length = <1>;
		gen-panel-pkt-dinfo-data-offset = <1>;
		gen-panel-pkt-dinfo-data-length = <1>;
		gen-panel-init-cmds = [
			39 00 00 00 00 04		B9 F1 08 00
			39 00 00 00 00 08		B1 31 0C 0C A7 11 01 F7
			39 00 00 00 00 04		C6 00 00 F7
			39 00 00 00 00 05		E3 03 03 03 03
			39 00 00 00 00 03		B8 06 22
			39 00 00 00 00 05		BF 0E 10 06 80
			39 00 00 00 00 13		BA 31 00 44 25 91 0A 00 00 C2 34 00 00 04
									02 1D B9 EE 40
			39 00 00 00 00 09		B3 00 00 00 00 0C 0A 25 20
			15 00 00 00 00 02		B0 00
			15 00 00 00 00 02		B4 00
			15 00 00 00 00 02		CC 0E
			15 00 00 00 00 02		BC 41
			15 00 00 00 00 02		B2 03
			39 00 00 00 00 06		C0 73 50 00 08 70
			39 00 00 00 00 34		E9 00 00 06 00 00 22 09 12 30 00 48 08 22
									09 47 03 00 00 00 00 00 18 00 00 89 98 33
									11 77 55 13 00 00 89 98 22 00 66 44 02 00
									00 00 00 00 00 00 00 00 00 00
			39 00 00 00 00 25		EA 00 00 98 98 44 66 00 22 20 00 00 98 98
									55 77 11 33 31 30 00 00 FF 00 5C 00 00 00
									00 00 00 00 00 00 00 00 00
			39 00 00 00 00 23		E0 01 08 09 26 28 3F 0E 2F 05 0B 0D 10 12
									10 12 31 37 01 08 09 26 28 3F 0E 2F 05 0B
									0D 10 12 10 12 31 37
			05 00 00 B4 00 01		11
			39 00 00 00 00 03		B8 04 22
			05 00 00 14 00 01		29
		];
		gen-panel-enable-cmds = [
			05 00 00 B4 00 01		11
			39 00 00 00 00 03		B8 04 22
			05 00 00 14 00 01		29
		];
		gen-panel-disable-cmds = [
			39 00 00 10 00 03		B8 06 22
			05 00 00 14 00 01		28
			05 00 00 96 00 01		10
		];
		gen-panel-read-id = [
			DA 00 01
			DB 00 01
			DC 00 01
		];
		gen-panel-read-status-reg = [0A];
		gen-panel-read-status-ok = [9A];
		status = "okay";
	};
};
