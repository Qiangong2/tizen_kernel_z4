/*
 * Copyright (C) 2013 Spreadtrum Communication Incorporated
 *               http://www.spreadtrum.com/
 *
 * This program is free software; you can redistribute it and/or modify
 * it under the terms of the GNU General Public License version 2 as
 * published by the Free Software Foundation.
 */

/ {
	sec-fuelgauge {
		compatible = "samsung,sec-fuelgauge";
		capacity-max = <1000>;
		capacity-max-margin = <1000>;
		capacity-min = <10>;
		fg-irq-attr = <0>;
		fuel-alert-soc = <1000>;
		temp_adc_channel = <0>;
		gpios = <&a_eic_gpio 0 0>;/* chg int */
		vmode = <0>; /* 1=Voltage mode, 0=mixed mode */
		alm_soc = <5>; /* SOC alm level %*/
		alm_vbat = <3500>; /* Vbat alm level mV*/
		soft_vbat_uvlo = <3150>;
		rint = <300>; /*battery internal impedance*/
		cnom = <1950>; /* nominal capacity in mAh */
		rsense_real = <199>; /* sense resistor 0.1mOhm from real environment*/
		rsense_spec = <200>; /* sense resistor 0.1mOhm from specification*/
		relax_current = <50>; /* current for relaxation in mA (< C/20) */
		cnom_temp_tab = <1025 1950	/*value = 1000 + temp*/
				1010 1880
				1000 1745>;
		rint_temp_tab = <1040 240
				1025 300
				1010 450
				1000 550>;
		ocv_table = <4330 100
					4243 95
					4187 90
					4133 85
					4082 80
					4035 75
					3993 70
					3953 65
					3900 60
					3863 55
					3837 50
					3817 45
					3800 40
					3787 35
					3775 30
					3758 25
					3739 20
					3706 15
					3685 10
					3659 5
					3400 0>;
		sprd_fgu: sprd_fgu{
			compatible = "sprd,sprd_fgu";
			interrupt-parent = <&adi>;
			interrupts = <4 0x0>;
		};
	};

	sec-battery {
		compatible = "samsung,sec-battery";
		battery,vendor = "SDI SDI";
		battery,charger_name = "sec-charger";
		battery,fuelgauge_name = "sec-fuelgauge";
		battery,technology = <2>; /* POWER_SUPPLY_TECHNOLOGY_LION */
		battery,batt_capacity = <2050>; /* full battery capacity in mAh */

		battery,chip_vendor = "SPRD";
		battery,temp_adc_type = <1>; /* SEC_BATTERY_ADC_TYPE_AP */

		battery,polling_time = <10 30 30 30 3600>;

		battery,adc_check_count = <5>;

		battery,cable_check_type = <4>; /* SEC_BATTERY_CABLE_CHECK_PSY */
		battery,cable_source_type = <3>; /* SEC_BATTERY_CABLE_SOURCE_EXTERNAL */
		battery,event_waiting_time = <600>;
		battery,polling_type = <1>; /* SEC_BATTERY_MONITOR_ALARM */
		battery,monitor_initial_count = <3>;

		battery,battery_check_type = <5>; /* SEC_BATTERY_CHECK_CHARGER */
		battery,check_count = <0>;
		battery,check_adc_max = <1440>;
		battery,check_adc_min = <0>;

		battery,ovp_uvlo_check_type = <4>; /* SEC_BATTERY_OVP_UVLO_CHGINT */

		battery,thermal_source = <2>; /* SEC_BATTERY_THERMAL_SOURCE_ADC */

		battery,temp_table_adc = <372 442 615 855 930 1056 1121 1245 1394 1469 1680
			1770 1948 2176 2415 2651 2878 3007 3083  3275  3339 3592 3828>;
		battery,temp_table_data = <850 800 700 600 570 520 500 450 430 410 360
			340 300 250 200 150 100 70 50 0 (-20) (-100) (-200)>;


		battery,temp_check_type = <2>; /* SEC_BATTERY_TEMP_CHECK_TEMP */
		battery,temp_check_count = <1>;
		battery,temp_high_threshold_event = <500>;
		battery,temp_high_recovery_event = <450>;
		battery,temp_low_threshold_event = <0>;
		battery,temp_low_recovery_event = <50>;
		battery,temp_high_threshold_normal = <500>;
		battery,temp_high_recovery_normal = <450>;
		battery,temp_low_threshold_normal = <0>;
		battery,temp_low_recovery_normal = <50>;
		battery,temp_high_threshold_lpm = <500>;
		battery,temp_high_recovery_lpm = <450>;
		battery,temp_low_threshold_lpm = <0>;
		battery,temp_low_recovery_lpm = <50>;
		battery,full_check_type = <7>; /* SEC_BATTERY_FULLCHARGED_CHGPSY */
		battery,full_check_type_2nd = <0>; /* SEC_BATTERY_FULLCHARGED_NONE */
		battery,full_check_count = <1>;
		battery,chg_gpio_full_check = <0>;
		battery,chg_polarity_full_check = <1>;

		battery,full_condition_type = <13>;
		battery,full_condition_soc = <100>;
		battery,full_condition_vcell = <4250>;

		battery,recharge_check_count = <5>;
		battery,recharge_condition_type = <4>; /* SEC_BATTERY_RECHARGE_CONDITION_VCELL */
		battery,recharge_condition_soc = <95>;
		battery,recharge_condition_vcell = <4300>;

		battery,charging_total_time = <18000>; /* 5 hrs */
		battery,recharging_total_time = <5400>;
		battery,charging_reset_time = <0>;
		battery,chg_irq_attr = <0x3>;

		battery,always_enable;

		battery,swelling_high_temp_block = <410>;
		battery,swelling_high_temp_recov = <360>;
		battery,swelling_low_temp_block = <100>;
		battery,swelling_low_temp_recov = <150>;

		battery,swelling_chg_current = <1500>;

		battery,swelling_drop_float_voltage = <4150>;
		battery,swelling_high_rechg_voltage = <4100>;
		battery,swelling_low_rechg_voltage = <4000>;

		battery,swelling_block_time = <600>;
		battery,chg_float_voltage = <4350>;


		/* Charger */
		charger,vbus_ctrl_gpio = <&d_gpio_gpio 64 0x00>;
		battery,input_current_limit = <700 500 500 700 500 700 700 500 500
			 700 700 700 700 500 700 300 700 700 300 700 700 500 500
			 500 500 500 500 500 500 500 500 500>;
		battery,fast_charging_current = <1500 0 1500 1500 1500 1500 1500 1500 0
			1500 1500 1500 1500 (-1) 1500 1500 1500 1500 1500 1500 1500 0 0
			0 0 0 0 0 0 0 0 0 >;
		battery,full_check_current_1st = <150 0 150 150 150 150 150 150 0 150
			150 150 150 0 150 150 150 150 150 150 150 0 0 0 0 0 0 0 0 0 0 0 >;
		battery,full_check_current_2nd = <1800 0 1800 1800 1800 1800 1800 1800 0 1800
			1800 1800 1800 0 1800 1800 1800 1800 1800 1800 1800 0 0 0 0 0 0 0 0 0 0 0 >;
	};
};

